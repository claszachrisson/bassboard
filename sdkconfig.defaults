## sdkconfig.defaults
```kconfig
# ESP32-WROVER-E-N8R8 / LVGL partial rendering.
CONFIG_SPIRAM=y
CONFIG_SPIRAM_USE_MALLOC=y
CONFIG_SPIRAM_MALLOC_RESERVE_INTERNAL=65536
CONFIG_ESPTOOLPY_FLASHSIZE_8MB=y
CONFIG_LV_COLOR_DEPTH_16=y
CONFIG_LV_FONT_MONTSERRAT_20=y
CONFIG_LV_FONT_MONTSERRAT_24=y

CONFIG_LV_USE_CUSTOM_MALLOC=y
CONFIG_LV_USE_THEME_DEFAULT=n
```
